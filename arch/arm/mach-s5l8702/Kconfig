## arch/arm/mach-s5l8702/Kconfig
```kconfig
if ARCH_S5L8702

choice
    prompt "S5L8702 board select"
    optional

config TARGET_CLASSIC1G
    bool "Apple iPod Classic 1G"

endchoice

config SYS_SOC
    default "s5l8702"

source "board/apple/classic1g/Kconfig"

endif
```

## arch/arm/mach-s5l8730/Kconfig
```kconfig
if ARCH_S5L8730

choice
    prompt "S5L8730 board select"
    optional

config TARGET_NANO5G
    bool "Apple iPod Nano 5G"

endchoice

config SYS_SOC
    default "s5l8730"

source "board/apple/nano5g/Kconfig"

endif
```

## board/apple/classic1g/Kconfig
```kconfig
if TARGET_CLASSIC1G

config SYS_BOARD
    default "classic1g"

config SYS_VENDOR
    default "apple"

config SYS_CONFIG_NAME
    default "appleclassic1g"

endif
```
